#include "U8glib.h"
#include <SPI.h>
#include <mcp2515.h>
#define CS_PIN 10 // pin Chip Select

struct can_frame canMsg;

MCP2515 mcp(CS_PIN);

U8GLIB_SSD1306_128X64 u8g(U8G_I2C_OPT_DEV_0|U8G_I2C_OPT_NO_ACK|U8G_I2C_OPT_FAST);	// Fast I2C / TWI 

// 'Centro_flecha[1]', 8x8px
const unsigned char epd_bitmap_Centro_flecha_1_ [] PROGMEM = {
  0x00, 0x00, 0x00, 0x00, 0x00, 0x00, 0x00, 0x00
};
// 'contorno_centro[1]', 8x8px
const unsigned char epd_bitmap_contorno_centro_1_ [] PROGMEM = {
  0x00, 0x3c, 0x42, 0x42, 0x42, 0x42, 0x3c, 0x00
};
// 'Gauge[1]', 71x64px
const unsigned char epd_bitmap_Gauge_1_ [] PROGMEM = {
  0x00, 0x00, 0x00, 0x00, 0x00, 0x00, 0x00, 0x00, 0x00, 0x00, 0x00, 0x00, 0x00, 0x00, 0x00, 0x00, 
  0x00, 0x00, 0x00, 0x00, 0x00, 0x00, 0x00, 0x00, 0x00, 0x00, 0x00, 0x00, 0x00, 0x00, 0x07, 0xff, 
  0x80, 0x00, 0x00, 0x00, 0x00, 0x00, 0x00, 0x78, 0x00, 0x78, 0x00, 0x00, 0x00, 0x00, 0x00, 0x01, 
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  0x00, 0x00, 0x00, 0x00, 0x00, 0x00, 0x00, 0x00, 0x00, 0x00, 0x00, 0x00, 0x00, 0x00, 0x00, 0x00
};
// 'KMH_letras[1]', 16x8px
const unsigned char epd_bitmap_KMH_letras_1_ [] PROGMEM = {
  0x00, 0x00, 0x94, 0x52, 0xa6, 0xd2, 0xc5, 0x5e, 0xa4, 0x52, 0x94, 0x52, 0x94, 0x52, 0x00, 0x00
};

// '0[1]', 16x28px
const unsigned char epd_bitmap_0_1_ [] PROGMEM = {
  0x0f, 0xff, 0x1f, 0xff, 0x7f, 0xff, 0xff, 0xff, 0xff, 0xff, 0xff, 0xff, 0xfc, 0x3f, 0xfc, 0x3f, 
  0xfc, 0x3f, 0xfc, 0x3f, 0xfc, 0x3f, 0xfc, 0x3f, 0xfc, 0x3f, 0xfc, 0x3f, 0xfc, 0x3f, 0xfc, 0x3f, 
  0xfc, 0x3f, 0xfc, 0x3f, 0xfc, 0x3f, 0xfc, 0x3f, 0xfc, 0x3f, 0xfc, 0x3f, 0xfc, 0x3f, 0xff, 0xff, 
  0xff, 0xff, 0xff, 0xfe, 0xff, 0xfc, 0xff, 0xf8
};
// '1[1]', 16x28px
const unsigned char epd_bitmap_1_1_ [] PROGMEM = {
  0x01, 0xf8, 0x03, 0xf8, 0x07, 0xf8, 0x1f, 0xf8, 0x1f, 0xf8, 0x1f, 0xf8, 0x1f, 0xf8, 0x1f, 0xf8, 
  0x01, 0xf8, 0x01, 0xf8, 0x01, 0xf8, 0x01, 0xf8, 0x01, 0xf8, 0x01, 0xf8, 0x01, 0xf8, 0x01, 0xf8, 
  0x01, 0xf8, 0x01, 0xf8, 0x01, 0xf8, 0x01, 0xf8, 0x01, 0xf8, 0x01, 0xf8, 0x01, 0xf8, 0x01, 0xf8, 
  0x01, 0xf8, 0x01, 0xf8, 0x01, 0xf8, 0x01, 0xf8
};
// '2[1]', 16x28px
const unsigned char epd_bitmap_2_1_ [] PROGMEM = {
  0x0f, 0xfe, 0x1f, 0xff, 0x3f, 0xff, 0x7f, 0xff, 0xff, 0xff, 0xff, 0xff, 0xfc, 0x3f, 0xfc, 0x3f, 
  0xfc, 0x3f, 0x00, 0x3f, 0x00, 0x7f, 0x00, 0xff, 0x01, 0xfe, 0x03, 0xfc, 0x07, 0xf8, 0x1f, 0xf0, 
  0x3f, 0xe0, 0x7f, 0x80, 0xff, 0x00, 0xfe, 0x00, 0xfc, 0x00, 0xfc, 0x00, 0xfc, 0x00, 0xff, 0xff, 
  0xff, 0xff, 0xff, 0xff, 0xff, 0xff, 0xff, 0xff
};
// '3[1]', 16x28px
const unsigned char epd_bitmap_3_1_ [] PROGMEM = {
  0x0f, 0xfe, 0x3f, 0xff, 0x7f, 0xff, 0xff, 0xff, 0xff, 0xff, 0xff, 0xff, 0xf8, 0x3f, 0xf8, 0x3f, 
  0xf8, 0x3f, 0x00, 0x3f, 0x00, 0x3f, 0x00, 0xfe, 0x01, 0xfc, 0x01, 0xf8, 0x01, 0xff, 0x01, 0xff, 
  0x00, 0xff, 0x00, 0x3f, 0x00, 0x3f, 0xf8, 0x3f, 0xf8, 0x3f, 0xf8, 0x3f, 0xfc, 0x3f, 0xff, 0xff, 
  0xff, 0xff, 0xff, 0xfe, 0xff, 0xfc, 0xff, 0xf8
};
// '4[1]', 16x28px
const unsigned char epd_bitmap_4_1_ [] PROGMEM = {
  0x00, 0xe0, 0x00, 0xf0, 0x01, 0xf8, 0x01, 0xfc, 0x03, 0xfe, 0x07, 0xfe, 0x07, 0xfe, 0x0f, 0xfe, 
  0x0f, 0xfe, 0x1f, 0xfe, 0x1f, 0x7e, 0x3f, 0x7e, 0x3e, 0x7e, 0x7e, 0x7e, 0x7c, 0x7e, 0xfc, 0x7e, 
  0xf8, 0x7e, 0xf8, 0x7e, 0xff, 0xff, 0xff, 0xff, 0x7f, 0xff, 0x7f, 0xff, 0x3f, 0xff, 0x00, 0x7e, 
  0x00, 0x7e, 0x00, 0x7e, 0x00, 0x7e, 0x00, 0x7e
};
// '5[1]', 16x28px
const unsigned char epd_bitmap_5_1_ [] PROGMEM = {
  0x7f, 0xfe, 0xff, 0xfe, 0xff, 0xfe, 0xff, 0xfe, 0xff, 0xfe, 0xff, 0xfe, 0xfc, 0x00, 0xfc, 0x00, 
  0xfc, 0x00, 0xfc, 0x00, 0xfe, 0x00, 0xff, 0xf0, 0xff, 0xf8, 0xff, 0xfc, 0xff, 0xfe, 0xff, 0xff, 
  0x00, 0x3f, 0x00, 0x3f, 0x00, 0x3f, 0xfc, 0x3f, 0xfc, 0x3f, 0xfc, 0x3f, 0xfc, 0x7f, 0xff, 0xff, 
  0xff, 0xff, 0x7f, 0xff, 0x3f, 0xff, 0x1f, 0xff
};
// '6[1]', 16x28px
const unsigned char epd_bitmap_6_1_ [] PROGMEM = {
  0x0f, 0xfe, 0x1f, 0xff, 0x3f, 0xff, 0x7f, 0xff, 0xff, 0xff, 0xff, 0xff, 0xfc, 0x3f, 0xfc, 0x3f, 
  0xfc, 0x3f, 0xfc, 0x00, 0xfc, 0x00, 0xff, 0xfe, 0xff, 0xff, 0xff, 0xff, 0xff, 0xff, 0xff, 0xff, 
  0xff, 0xff, 0xfc, 0x3f, 0xfc, 0x3f, 0xfc, 0x3f, 0xfc, 0x3f, 0xfc, 0x3f, 0xfc, 0x7f, 0xff, 0xff, 
  0xff, 0xfe, 0xff, 0xfc, 0xff, 0xf8, 0xff, 0xf0
};
// '7[1]', 16x28px
const unsigned char epd_bitmap_7_1_ [] PROGMEM = {
  0xff, 0xf0, 0xff, 0xf8, 0xff, 0xfc, 0xff, 0xfe, 0xff, 0xff, 0xff, 0xff, 0xf8, 0x3e, 0xf8, 0x7e, 
  0xf8, 0x7e, 0x00, 0xfc, 0x00, 0xfc, 0x00, 0xfc, 0x01, 0xf8, 0x01, 0xf8, 0x01, 0xf8, 0x03, 0xf0, 
  0x03, 0xf0, 0x07, 0xf0, 0x07, 0xe0, 0x07, 0xe0, 0x0f, 0xc0, 0x0f, 0xc0, 0x0f, 0xc0, 0x1f, 0x80, 
  0x1f, 0x80, 0x3f, 0x80, 0x3f, 0x00, 0x3f, 0x00
};
// '8[1]', 16x28px
const unsigned char epd_bitmap_8_1_ [] PROGMEM = {
  0x0f, 0xfe, 0x1f, 0xfe, 0x3f, 0xfe, 0x7f, 0xfe, 0xff, 0xfe, 0xff, 0xfe, 0xfc, 0x3e, 0xfc, 0x3e, 
  0xfc, 0x3e, 0xfc, 0x3e, 0xfc, 0x3e, 0xfc, 0x3e, 0xff, 0xfc, 0xff, 0xf8, 0x1f, 0xff, 0x7f, 0xff, 
  0xff, 0xff, 0xfc, 0x3f, 0xfc, 0x3f, 0xfc, 0x3f, 0xfc, 0x3f, 0xfc, 0x3f, 0xfc, 0x3f, 0xff, 0xff, 
  0xff, 0xff, 0xff, 0xfe, 0xff, 0xfc, 0xff, 0xf8
};
// '9[1]', 16x28px
const unsigned char epd_bitmap_9_1_ [] PROGMEM = {
  0x07, 0xff, 0x1f, 0xff, 0x3f, 0xff, 0x7f, 0xff, 0xff, 0xff, 0xff, 0xff, 0xfc, 0x3f, 0xfc, 0x3f, 
  0xfc, 0x3f, 0xfc, 0x3f, 0xfc, 0x3f, 0xff, 0xff, 0xff, 0xff, 0xff, 0xff, 0xff, 0xff, 0xff, 0xff, 
  0xff, 0xff, 0x00, 0x3f, 0x00, 0x3f, 0xfc, 0x3f, 0xfc, 0x3f, 0xfc, 0x3f, 0xfc, 0x3f, 0xff, 0xff, 
  0xff, 0xff, 0xff, 0xfe, 0xff, 0xfc, 0xff, 0xf8
};

// Array of all bitmaps for convenience. (Total bytes used to store images in PROGMEM = 800)
const int epd_bitmap_allArray_LEN = 10;
const unsigned char* epd_bitmap_allArray[10] = {
  epd_bitmap_0_1_,
  epd_bitmap_1_1_,
  epd_bitmap_2_1_,
  epd_bitmap_3_1_,
  epd_bitmap_4_1_,
  epd_bitmap_5_1_,
  epd_bitmap_6_1_,
  epd_bitmap_7_1_,
  epd_bitmap_8_1_,
  epd_bitmap_9_1_
};

int vel_string_start_position;
int velocidad = 0;
char vel_string[10];
int dato=0;
int vel_string_lenght;

int angulo_flecha=45;
int flecha_inicio_x;
int flecha_inicio_y;
int flecha_final_x;
int flecha_final_y;
int flecha_centro_x=35;
int flecha_centro_y=36;
int flecha_radio1=30;
int flecha_radio2=10;


void setup(void) {
  u8g.setFont(u8g_font_tpssb);
  u8g.setColorIndex(1);
  Serial.begin(9600);
  while (!Serial);

  SPI.begin();
  mcp.reset();
  mcp.setBitrate(CAN_125KBPS);
  mcp.setNormalMode();
  
}

void loop() {
  if (mcp.readMessage(&canMsg) == MCP2515::ERROR_OK) { // Verifica si lee el mensaje
    if (canMsg.can_id == 0x0E3) { // ID del mensaje enviado por el Gateway
    Serial.print("Valor recibido de: ");
    Serial.println(canMsg.can_id, HEX);
      dato = canMsg.data[0];
    }
  }
  velocidad=map(dato, 0, 100, 0, 140);
  itoa(velocidad, vel_string,10);
  vel_string_lenght=strlen(vel_string);
  vel_string_start_position = 99-vel_string_lenght*8;

  angulo_flecha = map(velocidad, 0, 140, 45, 315);

  flecha_inicio_x=flecha_radio1*-sin(radians(angulo_flecha))+flecha_centro_x;
  flecha_inicio_y=flecha_radio1*cos(radians(angulo_flecha))+flecha_centro_y;

  flecha_final_x=flecha_radio2*-sin(radians(angulo_flecha+180))+flecha_centro_x;
  flecha_final_y=flecha_radio2*cos(radians(angulo_flecha+180))+flecha_centro_y;
  
  u8g.firstPage();
  do{
    
    
    //u8g.drawStr(90,20,vel_string);
    for(int i = 0; i<vel_string_lenght; i++){
      u8g.drawBitmapP(vel_string_start_position+18*i, 16, 16/8, 28, epd_bitmap_allArray[vel_string[i]-48]);
    }
    u8g.drawBitmapP( 0, 0, 72/8, 64, epd_bitmap_Gauge_1_);
    u8g.drawLine(flecha_inicio_x, flecha_inicio_y, flecha_final_x, flecha_final_y);
    u8g.setColorIndex(0); //Black
    u8g.drawBitmapP( 31, 33, 8/8, 8, epd_bitmap_Centro_flecha_1_);
    u8g.setColorIndex(1);//White
    u8g.drawBitmapP( 31, 33, 8/8, 8, epd_bitmap_contorno_centro_1_);
    
    u8g.drawBitmapP( 93, 46, 16/8, 6, epd_bitmap_KMH_letras_1_);
    
  } while(u8g.nextPage());
  
}
